## boards/shields/ashok_macropad/Kconfig.defconfig
```kconfig
if SHIELD_MACROPAD

# Name must be less than 16 characters long!
config ZMK_KEYBOARD_NAME
    default "Ashok Macropad"

endif
```

## config/boards/arm/ashok_e73_board/Kconfig.board
```kconfig
# SPDX-License-Identifier: MIT

config BOARD_ASHOK_E73_BOARD
	bool "Ashok E73 Custom Board"
	depends on SOC_SERIES_NRF52X
	select SOC_NRF52840_QIAA
	select ARM_MPU
	select HAS_NRFX
```

## config/boards/arm/ashok_e73_board/Kconfig.defconfig
```kconfig
if BOARD_ASHOK_E73_BOARD

config BOARD
	default "ashok_e73_board"

config SOC
	default "nrf52840"

config SOC_NRF52840_QIAA
	default y

endif # BOARD_ASHOK_E73_BOARD
```

## config/boards/arm/ashok_e73_board/ashok_e73_board_defconfig
```kconfig
# SPDX-License-Identifier: MIT

# Board Configuration
CONFIG_BOARD_ASHOK_E73_BOARD=y

# Enable GPIO
CONFIG_GPIO=y

# Enable SERIAL
CONFIG_SERIAL=y
CONFIG_CONSOLE=y
CONFIG_UART_CONSOLE=y

# Enable USB
CONFIG_USB_DEVICE_STACK=y
CONFIG_USB_DEVICE_PRODUCT="Ashok Macropad"
CONFIG_USB_DEVICE_MANUFACTURER="Ashok Subedi"
CONFIG_USB_DEVICE_PID=0x0001
CONFIG_USB_DEVICE_VID=0x1209
CONFIG_USB_CDC_ACM=y
CONFIG_USB_DEVICE_INITIALIZE_AT_BOOT=y

# Enable Bluetooth
CONFIG_BT=y
CONFIG_BT_SMP=y
CONFIG_BT_PERIPHERAL=y
CONFIG_BT_GAP_PERIPHERAL_PREF_PARAMS=y
CONFIG_BT_DEVICE_NAME="Ashok Macropad"

# Enable SPI for LED strip
CONFIG_SPI=y

# Enable settings for bond storage
CONFIG_FLASH=y
CONFIG_FLASH_PAGE_LAYOUT=y
CONFIG_FLASH_MAP=y
CONFIG_NVS=y
CONFIG_SETTINGS=y
CONFIG_SETTINGS_NVS=y

# Enable ADC
CONFIG_ADC=y
```

## config/boards/shields/ashok_macropad/Kconfig.defconfig
```kconfig
if SHIELD_ASHOK_MACROPAD

# Name must be less than 16 characters long!
config ZMK_KEYBOARD_NAME
    default "Ashok Macropad"

# Enable encoder support
config EC11
    default y

# Enable display support
config ZMK_DISPLAY
    default y

config I2C
    default y

config SSD1306
    default y

config LVGL
    default y if ZMK_DISPLAY

endif
```

## config/boards/shields/ashok_macropad/Kconfig.shield
```kconfig
# No whitespace after the comma or in your keyboard name!
config SHIELD_ASHOK_MACROPAD
    def_bool $(shields_list_contains,ashok_macropad)   
```
